## drivers/video/tegra/Kconfig
```kconfig
trysource "../nvmap/drivers/video/tegra/nvmap/Kconfig"
trysource "../nvmap/drivers/video/tegra/nvmap/Kconfig.nvmap"
trysource "drivers/video/tegra/nvmap/Kconfig.nvmap"

trysource "../nvhost/drivers/video/tegra/Kconfig.nvhost"
trysource "drivers/video/tegra/Kconfig.nvhost"

if PLATFORM_TEGRA

trysource "../display/drivers/video/tegra/Kconfig.display"
trysource "drivers/video/tegra/Kconfig.display"

config TEGRA_DC
	tristate "Tegra Display Contoller"
	depends on (TEGRA_GRHOST || TEGRA_HOST1X) && I2C
	select BACKLIGHT_CLASS_DEVICE
	select FB_MODE_HELPERS
	help
	 Tegra display controller support.
	 Enable this to access the Tegra display controller using either framebuffer
	 console interface and a proprietary dc-ext interface or with ADF.
```
